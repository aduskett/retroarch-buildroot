## package/retroarch-assets/Config.in
```kconfig
config BR2_PACKAGE_RETROARCH_ASSETS
	bool "retroarch-assets"
	depends on BR2_PACKAGE_RETROARCH
	help
	  Janus is an open source, general purpose, WebRTC gateway
	  designed and developed by Meetecho.

	  https://github.com/meetecho/janus-gateway

comment "retroarch needs a toolchain w/ dynamic library, threads, wchar"
	depends on BR2_USE_MMU
	depends on BR2_STATIC_LIBS || !BR2_TOOLCHAIN_HAS_THREADS || !BR2_USE_WCHAR
```
